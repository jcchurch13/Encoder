/*

SAM21D18 (Arduino Zero compatible), AS5047 encoder, A4954 driver

Controlled via a SerialUSB terminal at 115200 baud.


____
    |
0005|-> LED 
0007|-> pulse         
0009|-> IN_1            
0010|-> IN_2            
0012|-> IN_3           
0011|-> IN_4             
    |->                   \
0008|-> VREF_1             \___A4954  
0013|-> VREF_2            _/           
   4|->                  
0006|-> chipSelectPin  
   2|
    |
 SCK|-> clockPin
MOSI|-> MISO
MISO|-> MOSI
____|
  

Implemented commands are:

p  -  print [step count] , [assumed angle] , [encoder reading]

c  -  clear step count & assumed angle

s  -  step

d  -  dir toggle

z  -  seek zero position

g  -  Go! steps around 400 times

w  -  Same as go, but stores encoder angles to EEPROM

r  -  returns EEPROM contents

a  -  prompts user to enter angle 

y  -  sine sweep



*/


//#include <EEPROM.h>
#include <math.h>
#include <avr/pgmspace.h>
#include <SPI.h>

const int spr = 500; //  400 steps per revolution
const float aps = 360.0/spr;  // angle per step

float kp = 50;
int ep = 0;
float ki =0.1;//180

float KF = 0.1;


int dir = 1;
int step_state = 1;



long angle = 0; //holds processed angle value
long angletemp;
float anglefloat = 0; 

int a = 0;  //angle value in zero routine
float offset = 0.000000000000000; //zero-offest of closest full step




int i_step = 0; // step index
int i_w = 0;// write index
int i_r = 0; // read index

//___________________________________

const float pi = 3.14159;
const int  half = 134;//128;

float new_angle = 0.0; //input angle
float current_angle = 0.0; //current angle
float diff_angle = 0.0;
int val1 = 0;
int val2 = 0;

//////////////////////////////////////
//////////////////PINS////////////////
//////////////////////////////////////
int IN_4 = 11;
int IN_3 = 12;
int VREF_2 = 13;
int VREF_1 = 8;
int IN_2 = 10;
int IN_1 = 9;
int pulse = 5;
int sine_out = 3;
int encoder_out= 4;

int step_pin  = 1;
int dir_pin = 2;

const int ledPin = 5; //LED connected to digital pin 13

const int chipSelectPin = 6; //output to chip select

volatile long step_count =0;

//////////////////////////////////////
//////////////////////////////////////
//////////////////////////////////////


float angle_out=0.0;
int zero_state =0;


const PROGMEM float sine_lookup[] = {
0.0,0.01,0.02,0.03,0.04,0.05,0.06,0.0699,0.0799,0.0899,0.0998,0.1098,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0.0116,0.0016};//,-0.0084,-0.0184,-0.0284,-0.0384,-0.0484,-0.0584,-0.0684,-0.0783,-0.0883,-0.0982,-0.1082,-0.1181,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-0.0132,




const PROGMEM float lookup[] = {
  
0.0,0.011,0.0221,0.0331,0.0442,0.0552,0.0663,0.0773,0.0883,0.0994,0.1104,0.1215,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356.3786,

};



void setup() {
  SerialUSB.begin(115200);

  while(!SerialUSB){};
      
  //TCCR0B = (TCCR0B & 0b11111000) | 0x01;      ---Delete
  
  pinMode(VREF_2, OUTPUT);
  pinMode(VREF_1, OUTPUT);
  pinMode(IN_4, OUTPUT);
  pinMode(IN_3, OUTPUT);
  pinMode(IN_2, OUTPUT);
  pinMode(IN_1, OUTPUT);
  pinMode(pulse, OUTPUT);
  pinMode(step_pin, INPUT);
  pinMode(dir_pin, INPUT);

  attachInterrupt(1,step_int, RISING);
  
  
  
  analogWrite(VREF_2, 64);  
  analogWrite(VREF_1, 64);  

  digitalWrite(IN_4, HIGH);
  digitalWrite(IN_3, LOW);
  digitalWrite(IN_2, HIGH);
  digitalWrite(IN_1, LOW);
 
  pinMode(ledPin, OUTPUT); // visual signal of I/O to chip
 // pinMode(clockPin, OUTPUT); // SCK
  pinMode(chipSelectPin, OUTPUT); // CSn -- has to toggle high and low to signal chip to start data transfer
//  pinMode(inputPin, INPUT); // SDA




    SPISettings settingsA(400000, MSBFIRST, SPI_MODE1); 
    
    SPI.begin();    //AS5047D SPI uses mode=1 (CPOL=0, CPHA=1)
    SerialUSB.println("Begin...");
    delay(1000);
    SPI.beginTransaction(settingsA); 

    delay(1000);

  //SerialUSB.print("DDRB , ");
  //SerialUSB.println(DDRB,BIN);
  //SerialUSB.print("DDRD , ");
  //SerialUSB.println(DDRD,BIN);
 // TCCR0B = (TCCR0B & 0b11111000) | 0x02;
 
   
//   SerialUSB.println(lookup_sine(-3140),DEC);
//   SerialUSB.println(lookup_sine(-2360),DEC);
//   SerialUSB.println(lookup_sine(-1570),DEC);
//   SerialUSB.println(lookup_sine(-79),DEC);
//   SerialUSB.println(lookup_sine(0),DEC);
//   SerialUSB.println(lookup_sine(79),DEC);
//   SerialUSB.println(lookup_sine(157),DEC);
//   SerialUSB.println(lookup_sine(236),DEC);
//   SerialUSB.println(lookup_sine(314),DEC);

  
}







void loop()
{
  while (
  SerialUSB.available()) {

    char inChar = (char)SerialUSB.read();
  //  inchar = 'y';   //        AUTO START IN Y MODE
    if (inChar == 'p') {
      print_angle();
      delay(50);
    }
    
    else if (inChar == 's') {
      one_step();  
      print_angle();
    }
    
    else if (inChar == 'd') {
       if (dir == 1){
         dir = 0;
       }
       else {
         dir = 1;
       }
    }
    
    else if (inChar == 'c') {
       i_step = 0;
       i_w = 0;
    }
    
    else if (inChar == 'z') {
      a = readEncoder();
      anglefloat = a * 0.02197265625;
      while (anglefloat >= aps){//0.9)
        one_step();
        delay(100);//10); 
        a = readEncoder();
        anglefloat = a * 0.02197265625;
        SerialUSB.println(anglefloat,DEC);
             
      }
      delay(100);
      offset = readEncoder();
      zero_state = step_state;
      SerialUSB.println(zero_state,DEC);
      SerialUSB.print(digitalRead(IN_1),DEC);
      SerialUSB.print(" , ");
      SerialUSB.print(digitalRead(IN_2),DEC);
      SerialUSB.print(" , ");
      SerialUSB.print(digitalRead(IN_3),DEC);
      SerialUSB.print(" , ");
      SerialUSB.println(digitalRead(IN_4),DEC);

     }
     else if (inChar == 'g') {
       for(int x = 0; x < spr; x++){
        one_step();
        a = readEncoder();
        anglefloat = a * 0.02197265625;
        //SerialUSB.print(i_step,DEC);
        //SerialUSB.print(" , ");
        //SerialUSB.print(i_step*0.9,DEC);
        //SerialUSB.print(" , ");
        //SerialUSB.println(a-offset, DEC);
        SerialUSB.println(anglefloat, DEC);
       }
     } 
     
     else if (inChar == 'w') {
       for(int x = 0; x < spr; x++){
        

        a = 0;
        delay(1000);
        a += readEncoder();
        delay(10);
         a += readEncoder();
        delay(10);
         a += readEncoder();
        delay(10);
         a += readEncoder();
        delay(10);
         a += readEncoder();
        delay(10);
         a += readEncoder();
        delay(10);
         a += readEncoder();
        delay(10);
         a += readEncoder();
        delay(10);
         a += readEncoder();
        delay(10);
         a += readEncoder();
        delay(10);
        a = a/10;

        
        
        i_w = 2*x;
        //EEPROM.put(i_w,a);
        one_step();
        anglefloat = a * 0.02197265625;
        //SerialUSB.print(i_step,DEC);
        //SerialUSB.print(" , ");
        //SerialUSB.print(i_step*0.9,DEC);
        //SerialUSB.print(" , ");
        //SerialUSB.println(a-offset, DEC);
      //  SerialUSB.println(anglefloat, DEC);
       SerialUSB.println(a, DEC);
       delay(100);
       }
     }    
      else if (inChar == 'r') {
       for(int x = 0; x < spr; x++){
        i_r = 2*x;
       
//        EEPROM.get(i_r,a);
        
        //anglefloat = a * 0.02197265625;
        //SerialUSB.print(i_step,DEC);
        //SerialUSB.print(" , ");
        //SerialUSB.print(i_step*0.9,DEC);
        //SerialUSB.print(" , ");
        //SerialUSB.println(a-offset, DEC);
        //SerialUSB.println(anglefloat, DEC);
        SerialUSB.println(a, DEC);
       }
     }
     
     
  else if (inChar == 'a')  {
     SerialUSB.println("Enter angle:");      //Prompt User for input
     while (SerialUSB.available()==0)  {     //Wait for new angle
    }   
     update_angle();
    }

    
  else if (inChar == 'l') {
     SerialUSB.println("Enter encoder count:");      //Prompt User for input
     while (SerialUSB.available()==0)  {     //Wait for new angle
    }   
     a=SerialUSB.parseFloat();
     angle_out= lookup_angle(a);
     SerialUSB.println(angle_out,DEC);
    }
    
  else if (inChar == 'f') {
  follow();
  }
  
  
  else if (inChar == 'x')  {
     SerialUSB.println("Enter angle:");      //Prompt User for input
     while (SerialUSB.available()==0)  {     //Wait for new angle
    }   
     setpoint();
    }



    else if (inChar == 'y') {
      sine();
    }
  
  }
    
       
     
     
}





float lookup_angle(int n)
{
   float a_out; 
   a_out = pgm_read_float_near(lookup+n);
  //SerialUSB.println(angle_out,DEC);
    return a_out;
}



//_____________________________________________________________________________

void follow()
{//insert modified setpoint code
  }



//_____________________________________________________________________________________________________________________________________________________________________________________________________________________________________________




void update_angle()     /////FOUND ISSUE: DIFF_ANGLE NEEDS TO BE COMPUTED BEFORE+/- PA
{
  int start =0;
  int finish = 0;
  static int U = 0;
  new_angle=SerialUSB.parseFloat();     
  diff_angle =(new_angle-current_angle);

    
  if (abs(diff_angle) > 0.05)  {
    while (1) {//(abs(diff_angle) >= 0.05)  
      start=micros();
      a = readEncoder();
      finish = micros();
      current_angle = lookup_angle(a);
      
      //SerialUSB.println(current_angle,DEC);
     // SerialUSB.print(" , ");
      
      if (diff_angle>0){
        current_angle +=1.2;//-=0.2;//+=0.4;
      }
      else{
        current_angle -=1.4;//6;
      }
              
      //SerialUSB.print(current_angle,DEC);
      //SerialUSB.print(" , ");
      //SerialUSB.println(lookup_angle(a),DEC);
      //SerialUSB.println(current_angle,DEC);
      
        U =abs(kp*diff_angle);                  //control effort
        if (U>150){                             //saturation limits max current command
          U = 150;
        }
      
      //  U = 150;
       //digitalWrite(pulse, !digitalRead(pulse));
//             PORTB ^= (B00010000);     //PULSE 
       
       output(current_angle,U);
       
      // SerialUSB.println(finish-start,DEC);
       
           if (SerialUSB.available() > 0) {
       new_angle=SerialUSB.parseFloat();
    }

      diff_angle =(new_angle-current_angle);  
      SerialUSB.println(diff_angle);

    
    }

  }

  a = readEncoder();
  SerialUSB.println(a);

}






void setpoint()     //////////////////////////////////////////////////    SETPOINT   ///////////////////////////////////////
{ 
  
  static float ei =0.0; 
  int start =0;
  int finish = 0;
  static int U = 0;  //control effort
  static float r = 0.0;  //setpoint
  static float y = 0.0;  // measured angle
  static float e = 0.0;  // e = r-y (error)
  static float p = 0.0;  // proportional effort
  static float i = 0.0;  // integral effort
  static float PA = 0.0;  //

  static float u = 0.0;
  static float u_1 = 0.0;
  static float e_1 = 0.0;
  static float u_2 = 0.0;
  static float e_2 = 0.0;
  static float u_3 = 0.0;
  static float e_3 = 0.0;
  static long counter= 0;
  
//  new_angle=SerialUSB.parseFloat();     
 // diff_angle =(new_angle-current_angle);

    r=SerialUSB.parseFloat();     
  e =(r-y);

    
  if (abs(e) > 0.00)  {
    while (1) {//(abs(diff_angle) >= 0.05)  
      
      a = readEncoder();
      y = lookup_angle(a);

//      SerialUSB.print(r,DEC);
//      SerialUSB.print(" , ");
//      SerialUSB.print(y,DEC);
//      SerialUSB.print(" , ");
//      SerialUSB.println(e,DEC); 
      e =(r-y);  
//   if (e>0){
//        y +=0.9;
//      }
//      else{
//        y -=0.9;
//      }

 //    p=(kp*e);///////////////////
//      i = i+ki*e;
//      if (i>1){
//      i = 1;
//      }
//      else if (i <-1){
//        i = -1;
//      }

//
//
//    PA =(e*KF)+i;

//        if (PA>1.5){                          
//          PA = 1.5;
//        }
//        else if (PA<-1.5){
//          PA = -1.5;
//        }



             
   //   SerialUSB.print(y,DEC);
     // SerialUSB.print(" , ");
   //   SerialUSB.println(e,DEC);
      //  ei = 0.95*(ei+diff_angle);


 //     u = 0.7987*u_1 + kp*((10*e)-(9.799*e_1));     //////////////LOOKIN GOOD!  Gain Like 100?...200
//      e_1 = e;


 //     u = 1.597*u_1 - 0.638*u_2 + kp*((1.817*e_1)-(1.776*e_2));     //////////////LOOKIN GOOD! with LPF (gain like 30)

        u = 1.276*u_1 - 0.407*u_2 + kp*((2.943*e_1)-(2.812*e_2)); 

     // u = 2.597*u_1 - 2.235*u_2 + 0.6378*u_3 + kp*((1.819*e_1)-(0.3593*e_2)+(0.1774*e_3));

      e_3 = e_2;
      e_2 = e_1;
      e_1 = e;
      //u_1 = u;

     // u = p;/////////////////////
    
      if (u>0){
        PA = 1.3;
      }
      else {
        PA = -1.5;
      }
      

      y += PA;

      
   

        if (u>200){                             //saturation limits max current command
          u = 200;
        }
        else if (u<-200){
          u = -200;
        }
        u_3 = u_2;
      u_2 = u_1;  
      u_1 = u;
       U =abs(u);///p);//+i);

     // U = 200;
//      if (abs(e)<=0.1){
//        U = 100;
//      }


      if (abs(e)<0.15){
        digitalWrite(pulse, HIGH);       
      }
      else  {
        digitalWrite(pulse, LOW);
      }
     //  digitalWrite(pulse, HIGH);
    
     //  digitalWrite(pulse, LOW);
      //       PORTB ^= (B00010000);     //PULSE 
       
       output(y,U);


      analogWrite(3,map(u,-200,200,0,255));
      analogWriteResolution(12);
      analogWrite(4,(a>>2));
      analogWriteResolution(8);


//           if (SerialUSB.available() > 0) {         ///SERIAL UPDATE
//       r=SerialUSB.parseFloat();
//    }




//            counter +=1;                          ////COUNTER UPDATE
//        
//            if (counter>10000)
//            {
//              r = 110;
//            }
//        
//            else
//            {
//              r = 90;
//            }
//            if (counter>20000)
//            {
//              counter = 0;
//            }
//        
//            
//            }


    r=0.1*step_count;                                 ///// STEP/DIR INPUTS
    }


  }

  a = readEncoder();
  SerialUSB.println(a);

}





void one_step(){            /////////////////////////////////   ONE_STEP    ///////////////////////////////

  if (dir == 0) {
        i_step += 1;     
  }
   else{
        i_step -= 1;      
  }
  step_state = ((((i_step+zero_state) % 4)+4)%4);   // arduino mod does not wrap for negative....

  
  
 // SerialUSB.println(dir,DEC);
 // SerialUSB.println(step_state,DEC);

  
      
  analogWrite(VREF_2, 64);  
  analogWrite(VREF_1, 64);  
    if (step_state == 0){
        digitalWrite(IN_4, HIGH);
        digitalWrite(IN_3, LOW);
        digitalWrite(IN_2, HIGH);
        digitalWrite(IN_1, LOW);
    }
    else if (step_state == 1){

        digitalWrite(IN_4, LOW);
        digitalWrite(IN_3, HIGH);
        digitalWrite(IN_2, HIGH);
        digitalWrite(IN_1, LOW);
    }
    else if (step_state == 2){
        digitalWrite(IN_4, LOW);
        digitalWrite(IN_3, HIGH);
        digitalWrite(IN_2, LOW);
        digitalWrite(IN_1, HIGH);
    }
     else if (step_state == 3){
        digitalWrite(IN_4, HIGH);
        digitalWrite(IN_3, LOW);
        digitalWrite(IN_2, LOW);
        digitalWrite(IN_1, HIGH);
        
     }
      delay(10);
}


void print_angle()                ///////////////////////////////////       PRINT_ANGLE   /////////////////////////////////
{       
        a = 0;
        delay(100);
        a += readEncoder();
        delay(10);
         a += readEncoder();
        delay(10);
         a += readEncoder();
        delay(10);
         a += readEncoder();
        delay(10);
         a += readEncoder();
        delay(10);
         a += readEncoder();
        delay(10);
         a += readEncoder();
        delay(10);
         a += readEncoder();
        delay(10);
         a += readEncoder();
        delay(10);
         a += readEncoder();
        delay(10);
        a = a/10;

        anglefloat = a * 0.02197265625;
        SerialUSB.print(i_step,DEC);
        SerialUSB.print(" , ");
        SerialUSB.print(i_step*aps,DEC);
        SerialUSB.print(" , ");
        SerialUSB.print(a,DEC);
        SerialUSB.print(" , ");
        //SerialUSB.println(a-offset, DEC);
        SerialUSB.println(anglefloat, DEC);
}


void output(float theta,int effort){                      //////////////////////////////////////////   OUTPUT   ///////////////////
      static int start = 0;
      static int finish = 0;
      static int intangle;
      static float floatangle;
      static int modangle;
  
      // val1 = effort*sin( ((spr/4.0)*(theta*pi)/180) + ((pi/4)*(6.5)));//(5+ 2*zero_state)));//3

      floatangle= (100*( theta*0.87266 + 5.1051) );
      intangle = (int)floatangle;
      modangle = (((intangle% 628)+628)%628);
      val1 = effort*lookup_sine(intangle);
      
      analogWrite(VREF_2, abs(val1));
      
      if (val1 >= 0)  {
        digitalWrite(IN_4, HIGH);
   //     PORTB |= (B00000001);
 
        digitalWrite(IN_3,LOW);
    //    PORTB &= ~(B00000010);

      }
      else  {
        digitalWrite(IN_4, LOW);
      //  PORTB &= ~(B00000001);
 
        digitalWrite(IN_3, HIGH);
    //    PORTB |= (B00000010);
 
      }
      
      
      //val2 = effort*sin( ((spr/4.0)*(theta*pi)/180) + ((pi/4)*(4.5)));//(3+ 2*zero_state))); //1
      //val2 = effort*sin( 1.74533*current_angle + 3.927);
      
      floatangle= (100*(  theta*0.87266 +3.5343) );
      intangle = (int)floatangle;
      modangle = (((intangle% 628)+628)%628);
      val2 = effort*lookup_sine(intangle);

      analogWrite(VREF_1, abs(val2));  
      
            if (val2 >= 0)  {
        digitalWrite(IN_2, HIGH);
   //     PORTB |= (B00000100);
        digitalWrite(IN_1,LOW);
   //     PORTB &= ~(B00001000);
        
      }
      else  {
        digitalWrite(IN_2, LOW);
     //   PORTB &= ~(B00000100);
        digitalWrite(IN_1, HIGH);
     //   PORTB |= (B00001000);
        
      } 
  
  
  
  
  
}

int readEncoder()           //////////////////////////////////////////////////////   READENCODER   ////////////////////////////
{

  digitalWrite(chipSelectPin, LOW);

  //angle = SPI.transfer(0xFF);
  byte b1 = SPI.transfer(0xFF);
  byte b2 = SPI.transfer(0xFF);
  
  
  angletemp = (((b1<<8)|b2) & 0B0011111111111111);
  //  SerialUSB.println((angle & 0B0011111111111111)*0.02197265625);

  digitalWrite(chipSelectPin, HIGH);
  return angletemp; 
  


  
}



float lookup_sine(int m)        /////////////////////////////////////////////////  LOOKUP_SINE   /////////////////////////////
{
   float b_out; 
   
    m = (((m% 628)+628)%628);
   
   if (m>314){
   m =m-314;
     b_out = -pgm_read_float_near(sine_lookup+m);
  
  }
   else
   {
   b_out = pgm_read_float_near(sine_lookup+m);
   }
  //SerialUSB.println(angle_out,DEC);
    return b_out;
}


void sine()   ////////////////////////////////////////////////////////////////  SINE   //////////////////////////////
{ 
  
  static float ei =0.0; 
  int start =0;
  int finish = 0;
  static int U = 0;  //control effort
  static float r = 0.0;  //setpoint
  static float y = 0.0;  // measured angle
  static float e = 0.0;  // e = r-y (error)
  static float p = 0.0;  // proportional effort
  static float i = 0.0;  // integral effort
  static float PA = 0.0;  //

  static float u = 0.0;
  static float u_1 = 0.0;
  static float e_1 = 0.0;
  static long counter= 0;
  
//  new_angle=SerialUSB.parseFloat();     
 // diff_angle =(new_angle-current_angle);

  e = 1.0;

    
  if (abs(e) > 0.00)  {
    while (1) {//(abs(diff_angle) >= 0.05)  
      
      a = readEncoder();
      y = lookup_angle(a);

//      SerialUSB.print(r,DEC);
//      SerialUSB.print(" , ");
//      SerialUSB.print(y,DEC);
//      SerialUSB.print(" , ");
//      SerialUSB.println(e,DEC); 
     //e =(r-y);  
//   if (e>0){
//        y +=0.9;
//      }
//      else{
//        y -=0.9;
//      }

  //  p=(kp*e);
//      i = i+ki*e;
//      if (i>1){
//      i = 1;
//      }
//      else if (i <-1){
//        i = -1;
//      }

//
//
//    PA =(e*KF)+i;
//        if (PA>1.5){                          
//          PA = 1.5;
//        }
//        else if (PA<-1.5){
//          PA = -1.5;
//        }



             
   //   SerialUSB.print(y,DEC);
     // SerialUSB.print(" , ");
   //   SerialUSB.println(e,DEC);
      //  ei = 0.95*(ei+diff_angle);


     // u = 0.9694*u_1 + kp*0.03062*(e);//- 0.99999*e_1);
     // e_1 = e;
      //u_1 = u;

      u = 100* sin(0.015*counter);
    
      if (u>0){
        PA = 1.3;
      }
      else {
        PA = -1.5;
      }
      

      y += PA;

      
   

        if (u>200){                             //saturation limits max current command
          u = 200;
        }
        else if (u<-200){
          u = -200;
        }
      //u_1 = u;
       U =abs(u);///p);//+i);

     // U = 200;
//      if (abs(e)<=0.1){
//        U = 100;
//      }


      if (abs(e)<0.15){
        digitalWrite(pulse, HIGH);       
      }
      else  {
        digitalWrite(pulse, LOW);
      }
     //  digitalWrite(pulse, HIGH);
    
     //  digitalWrite(pulse, LOW);
      //       PORTB ^= (B00010000);     //PULSE 
       
       output(y,U);
//           if (SerialUSB.available() > 0) {
//       r=SerialUSB.parseFloat();
//    }
    analogWrite(3,map(u,-200,200,0,255));
   
    analogWrite(4,(a>>7));

    counter +=1;

    if (counter>20000)
    {
      counter = 0;
    }

    
    }

  }

  a = readEncoder();
  SerialUSB.println(a);

}


void step_int() {
  if(digitalRead(dir_pin))
  {
  step_count +=1;
  }
  else
  {
  step_count -=1;
  }


}


